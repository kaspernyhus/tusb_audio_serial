## sdkconfig.defaults
```kconfig
#
# ESP TinyUSB Audio
#
CONFIG_ESP_TINYUSB_DEBUG_LEVEL=0

#
# TinyUSB task configuration
#
CONFIG_ESP_TINYUSB_TASK_PRIORITY=5
CONFIG_ESP_TINYUSB_TASK_STACK_SIZE=4096
# end of TinyUSB task configuration

#
# Audio Device Class (UAC2)
#
CONFIG_ESP_TINYUSB_AUDIO_ENABLED=y
CONFIG_ESP_TINYUSB_AUDIO_SAMPLE_RATE=48000
CONFIG_ESP_AUDIO_16_BIT=y
# CONFIG_ESP_AUDIO_24_BIT is not set
# CONFIG_ESP_AUDIO_1_CH is not set
CONFIG_ESP_AUDIO_2_CH=y
# CONFIG_ESP_AUDIO_4_CH is not set
CONFIG_AUDIO_BYTES_PER_SAMPLE=2
CONFIG_AUDIO_CHANNELS=2
# end of Audio Device Class (UAC2)

#
# Communication Device Class (CDC)
#
CONFIG_ESP_TINYUSB_CDC_ENABLED=y
CONFIG_ESP_TINYUSB_CDC_RX_BUFSIZE=64
CONFIG_ESP_TINYUSB_CDC_TX_BUFSIZE=64
# end of Communication Device Class (CDC)
```
